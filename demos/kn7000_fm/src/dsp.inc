# (c) 2026 Felipe Correa da Silva Sanches <juca@members.fsf.org>
# Licensed under the terms of the GNU General Public License v3 or later
#
# dsp.inc -- the equates of dsp.s (the effects DSP: the host-port routines, the FM engine's load and commands).
# The DV_* layout and the host-port constants are Another World's (technics-anotherworld kn7000/src/dsp.inc),
# whose routines dsp.s copies; the bank's are left out.

.include "dsp_equ.inc"              # generated by tools/fm_dsp.py

# ---- DSP_HOST (kn7fm.inc), zeroed by the loader with the whole application area -----------------------------
.equ DV_STATE,     DSP_HOST + 0x00  # DS_* below
.equ DV_FAIL,      DSP_HOST + 0x04  # why the DSP is not used (DF_* codes below), 0 = it is
.equ DV_DWAIT,     DSP_HOST + 0x08  # the firmware's DSP routines (`calls` entries), as DspFind found them
.equ DV_DREGWR,    DSP_HOST + 0x0C  #   2x16 register write (d0 = register, d1 = high half, (0x10, sp) = low half)
.equ DV_DREGRD,    DSP_HOST + 0x10  #   2x16 register read (d0 = register)
.equ DV_DIDXWR,    DSP_HOST + 0x14  #   guarded index write (d0 = index)
.equ DV_DDATARD,   DSP_HOST + 0x18  #   guarded data-port read
.equ DV_DDATAWR,   DSP_HOST + 0x1C  #   guarded data-port write (d0 = 0x9C4, d1 = 16 bits)
.equ DV_DDEAD,     DSP_HOST + 0x20  #   the firmware's "DSP dead" flag (byte)
.equ DV_DDOWN,     DSP_HOST + 0x24  #   its "kernel downloaded" flag (byte)
.equ DV_FOUND,     DSP_HOST + 0x28  # DFB_* bits
.equ DV_SYSCON,    DSP_HOST + 0x2C
.equ DV_DMAC0,     DSP_HOST + 0x30  # DMAC0, IIEP0, IMEP0, CEP0 as found (put back at the end)
.equ DV_IIEP0,     DSP_HOST + 0x34
.equ DV_IMEP0,     DSP_HOST + 0x38
.equ DV_CEP0,      DSP_HOST + 0x3C
.equ DV_DMASTAT,   DSP_HOST + 0x40
.equ DV_SLOT0_HI,  DSP_HOST + 0x44  # unit 0's CALL slot as found (the firmware's): bits 47-32,
.equ DV_SLOT0_LO,  DSP_HOST + 0x48  #   bits 31-0
.equ DV_SLOT9_HI,  DSP_HOST + 0x4C  # unit 9's
.equ DV_SLOT9_LO,  DSP_HOST + 0x50
.equ DV_HOOKED,    DSP_HOST + 0x54  # bit 0: unit 0's slot is ours, bit 1: unit 9's
.equ DV_U9,        DSP_HOST + 0x58  # 1 when unit 9's slot is the kernel's form: it is hooked too
.equ DV_RBFAIL,    DSP_HOST + 0x5C  # the last readback stopped early
.equ DV_READY,     DSP_HOST + 0x64  # 1: the engine is loaded and hooked
.equ DV_PEND,      DSP_HOST + 0x80  # (Another World's DspUnhook clears it; unused here)
.equ DV_LASTCALLS, DSP_HOST + 0x84  # the watchdog (DspWatch): converter calls last seen,
.equ DV_LASTMS,    DSP_HOST + 0x88  #   and when they last changed
.equ DV_SIGN0,     DSP_HOST + 0x98  # DspFindStep: sig_dspwait's hits, and the first
.equ DV_SIGA0,     DSP_HOST + 0x9C
.equ DV_SIGN1,     DSP_HOST + 0xA0  # sig_dspregs's
.equ DV_SIGA1,     DSP_HOST + 0xA4
.equ DV_RBBUF,     DSP_HOST + 0x200 # 0x200 bytes: words read back (6 bytes a PM word, 4 a DM word)
.equ RB_WORDS,     0x50             # PM words read back at a time (0x50 x 6 = 0x1E0 bytes)

.equ DS_NONE,      0                # DV_STATE: not prepared
.equ DS_READY,     2                #   loaded and hooked
.equ DS_OFF,       3                #   given up (DV_FAIL), or released: the firmware's slots are back

.equ DFB_WAIT,     1                # DV_FOUND bits
.equ DFB_REGS,     2
.equ DFB_IDX,      4
.equ DFB_DATA,     8
.equ DFB_WRITE,    0x10
.equ DFB_ALL,      0x1F

.equ DF_NOTFOUND,  1                # DV_FAIL: the firmware's DSP routines were not all found
.equ DF_DEAD,      2                #   the firmware's dead flag was set
.equ DF_NOTDOWN,   3                #   the kernel was never downloaded
.equ DF_STATE,     4                #   SYSCON, DMAC0 or DMASTAT not as the firmware leaves them
.equ DF_SLOT,      5                #   a slot could not be read back, or is not the kernel's "CALL (0x8xxx) (DB)"
.equ DF_VERIFY,    6                #   the engine read back different
.equ DF_HOOK,      7                #   a hooked slot read back different
.equ DF_WATCH,     11               #   the firmware stopped calling the converter: released (DspWatch)
.equ DF_RUNTIME,   12               #   the dead flag was set while playing

# ---- DSP host-port constants (TRM Tables E-15, E-16; the firmware's own values; DSPTONE dsptone.inc) ----------
.equ IOP_SYSCON,   0x00
.equ IOP_EPB0,     0x04
.equ IOP_DMAC0,    0x1C
.equ IOP_DMASTAT,  0x37
.equ IOP_IIEP0,    0x40
.equ IOP_IMEP0,    0x41
.equ IOP_CEP0,     0x42
.equ DMAC_UP_PM,   0xA1             # the firmware's PM upload: DEN | DTYPE | PMODE 10 (16 -> 48)
.equ DMAC_UP_DM,   0x41             # its DM upload: DEN | PMODE 01 (16 -> 32)
.equ DMAC_CLOSE,   0xA0             # what it writes after each block (DEN off)
.equ DMAC_RB_PM,   0xA5             # readback (the ROM dumper's pass 7): the same with TRAN
.equ DMAC_RB_DM,   0x45
.equ DMAC_FLSH,    0x2000
.equ DMAC_KEEP,    0x1FE4           # the bits put back: not DEN, CHEN, the read-only PS/FS, not FLSH
.equ DATA_PORT,    0x9C4            # the firmware's id of the data port 0x9C000000
.equ FS_POLLS,     1000             # DMAC0 reads waiting for EPB0 to hold a word (readback)
.equ WATCH_MS,     5000             # no converter call for this long: the firmware has left (DspWatch)
