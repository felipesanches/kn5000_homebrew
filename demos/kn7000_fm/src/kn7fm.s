# (c) 2026 Felipe Correa da Silva Sanches <juca@members.fsf.org>
# Licensed under the terms of the GNU General Public License v3 or later
#
# kn7fm.s -- KN7FM: a DX7-style FM synthesizer for the Technics SX-KN7000 (README.md). An application of the
# program loader KN7LOAD.CNV (technics-roms-disasm kn7000/tools/cnv_romdump; kn7cnv.inc is the contract), started
# from the program menu (folder KN7FM\). The sound is computed by our program in the effects DSP (dsp.s; the
# program itself is tools/fm_dsp.py's); this one, on the main CPU, finds the firmware's services, loads the DSP,
# reads the keybed's notes and gives them to the DSP's voices (synth.s), and runs the editor (ui.s).
#
# The loader calls FmEntry on every converter call, on the firmware's main task (about 20 times a second). Each
# call does one step and returns:
#   * the first FW_STEPS calls find the firmware's routines and RAM (fwfind.s, Another World's search): the panel,
#     the millisecond counter and yield, the loader's file routines, the task services, the MIDI rings, the DSP's
#     host-port routines;
#   * then the bank: BANK0.SYX from the program's folder when it is a DX7 bank, else the built-in one;
#   * then the DSP (dsp.s DspPrepare: checked, loaded, read back, hooked), and our task starts;
#   * from then on each call serves the task's file requests (LOAD and SAVE read and write the card here, on the
#     main task, as the firmware's file layer expects) and watches EXIT.
# Holding EXIT for QUIT_MS asks the task to end: it releases the voices and gives the keybed its sound back; the
# next call puts the DSP's slots back and answers 0xFE, which hands the instrument back (EXIT, then "Continue
# Next?"). While it runs, every call answers request 1, which parks the firmware without repainting the screen:
# the screen is ours (ui.s draws it again if the firmware ever does).
#
# The task (FmTask) yields every millisecond: the keybed's notes (synth.s NotePoll) go to the DSP within a
# millisecond or two; between them it reads the panel, sends edits to the DSP and draws, a piece at a time.
#
# Calling convention: d0, d1, a0, a1 scratch; d2, d3, a2, a3 preserved. A routine that calls anything makes a frame
# first (movm + add -0x20, sp): the firmware's routines store into 4..0x10(sp) of their caller's frame, so a
# routine's own locals live at 0x14..0x1C(sp) (0x14..0x2C in the 0x30 frames).

.include "kn7cnv.inc"               # the loader's contract (technics-roms-disasm cnv_romdump)
.include "kn7fm.inc"
.include "dsp.inc"                  # dsp.s's equates, and the DSP program's addresses (dsp_equ.inc)
.include "fm_equ.inc"               # generated by tools/fm_host.py: the model's constants
.mnbase APP_BASE

# ---- the application header (kn7cnv.inc AH_*); mkapp.py fills in the size and the CRC-32 ------------------------
AppHeader:
    .ascii  "KN7A"
    .long   LOADER_ABI
    .long   0
    .long   FmEntry
    .long   0
    .long   APP_BASE
    .long   0, 0
    .ascii  "KN7FM DX7-STYLE FM SYNTHESIZER"
    .space  AppHeader + 0x40 - .

# =================================================================================================================
FmEntry:
    movm    [d2,d3,a2,a3], (sp)
    add     -0x20, sp
    mov     (V_CALLS), d0
    inc     d0
    mov     d0, (V_CALLS)
    mov     (V_STATE), d0
    cmp     ST_FIRST, d0
    beq     fe_first
    cmp     ST_SEARCH, d0
    beq     fe_search
    cmp     ST_BANK, d0
    beq     fe_bank
    cmp     ST_DSP, d0
    beq     fe_dsp
    cmp     ST_RUN, d0
    beq     fe_run
    bra     fe_exit

fe_first:                           # a fresh load: everything here is zero
    call    LaunchFolder, 0, 0
    mov     ST_SEARCH, d0
    mov     d0, (V_STATE)
    mov     0xFF, d0
    mov     d0, (V_ALG)
    mov     NVOICES, d0
    mov     d0, (V_NV)
    bra     fe_answer
fe_search:                          # one step of the firmware search per call
    mov     (V_STEP), d0
    call    FwStep, 0, 0
    cmp     0, d0
    bne     fe_search_fail
    mov     (V_STEP), d0
    inc     d0
    mov     d0, (V_STEP)
    cmp     FW_STEPS, d0
    bcs     fe_answer
    mov     (DV_FOUND), d0          # the DSP's routines must all be there: there is no sound without them
    cmp     DFB_ALL, d0
    beq     fe_found
    mov     FAIL_DSP + DF_NOTFOUND, d0
    bra     fe_fail
fe_found:
    mov     ST_BANK, d0
    mov     d0, (V_STATE)
    bra     fe_answer
fe_search_fail:
    mov     (V_STEP), d0
    add     FAIL_FW, d0
    bra     fe_fail
fe_bank:                            # BANK0.SYX when it is a bank, else the built-in one
    clr     d0
    mov     d0, (V_FILENO)
    call    ReadBank, 0, 0
    cmp     0, d0
    bne     fe_builtin
    mov     (V_FBYTES), d0
    call    BankFromFile, 0, 0
    cmp     0, d0
    bne     fe_builtin
    mov     1, d0
    mov     d0, (V_BANKSRC)
    bra     fe_banked
fe_builtin:
    mov     T_BANK, a0
    call    BankUnpack, 0, 0
    clr     d0
    mov     d0, (V_BANKSRC)
fe_banked:
    mov     ST_DSP, d0
    mov     d0, (V_STATE)
    bra     fe_answer
fe_dsp:                             # the DSP, then the task
    call    DspPrepare, 0, 0
    cmp     0, d0
    beq     fe_start
    mov     (DV_FAIL), d0
    add     FAIL_DSP, d0
    bra     fe_fail
fe_start:
    call    StartTask, 0, 0
    cmp     0, d0
    beq     fe_started
    call    DspQuit, 0, 0
    mov     FAIL_TASK, d0
    bra     fe_fail
fe_started:
    mov     ST_RUN, d0
    mov     d0, (V_STATE)
    bra     fe_exit
fe_run:                             # the task's file requests
    mov     (V_FREQ), d0
    cmp     0, d0
    beq     fe_exit
    mov     (V_FRES), d1
    cmp     0, d1
    bne     fe_exit                 # answered, not yet taken
    cmp     1, d0
    bne     fe_write
    call    ReadBank, 0, 0
    bra     fe_fres
fe_write:
    call    WriteBank, 0, 0
fe_fres:
    mov     1, d1                   # 1 done, 2 failed
    cmp     0, d0
    beq     fe_fres2
    mov     2, d1
fe_fres2:
    mov     d1, (V_FRES)
    bra     fe_exit
fe_fail:
    mov     d0, (V_FAIL)
    mov     ST_FAIL, d0
    mov     d0, (V_STATE)
    mov     1, d0
    mov     d0, (V_TASKDONE)

fe_exit:                            # EXIT held for QUIT_MS: leave (the firmware ignores EXIT while we answer)
    mov     (FWV_PANEL), a0
    cmp     0, a0
    beq     fe_answer
    mov     (FWV_KERNEL_MS), a1
    cmp     0, a1
    beq     fe_answer
    movbu   (EXIT_OFS, a0), d0
    btst    EXIT_BIT, d0
    beq     fe_exit_up
    mov     (V_EXIT_T0), d1
    cmp     0, d1
    bne     fe_exit_held
    mov     (a1), d1
    or      1, d1
    mov     d1, (V_EXIT_T0)
    bra     fe_answer
fe_exit_held:
    mov     (a1), d0
    sub     d1, d0
    cmp     QUIT_MS, d0
    bcs     fe_answer
    mov     1, d0
    mov     d0, (V_QUIT)
    bra     fe_answer
fe_exit_up:
    clr     d0
    mov     d0, (V_EXIT_T0)

fe_answer:
    mov     (V_QUIT), d0
    cmp     0, d0
    beq     fe_park
    mov     (V_TASKDONE), d0
    cmp     0, d0
    beq     fe_park                 # the task leaves first
    call    DspQuit, 0, 0           # the slots as the firmware had them, read back
    mov     MAILBOX, a0
    mov     RQ_END, d0
    movbu   d0, (a0)
    mov     1, d0
    mov     d0, (V_ENDED)
    bra     fe_ret
fe_park:
    mov     MAILBOX, a0
    mov     (V_STATE), d0
    cmp     ST_RUN, d0
    bne     fe_text
    mov     RQ_PARK, d0             # running: call again, leave the screen alone
    movbu   d0, (a0)
    clr     d0
    movbu   d0, (1, a0)
    movbu   d0, (2, a0)
    movbu   d0, (3, a0)
    movbu   d0, (4, a0)
    bra     fe_ret
fe_text:
    mov     RQ_TEXT, d0             # starting, or failed: our text
    movbu   d0, (a0)
    call    AnswerText, 0, 0        # a1 = the text
    inc     a0
fe_cpy:
    movbu   (a1), d0
    movbu   d0, (a0)
    inc     a0
    inc     a1
    cmp     0, d0
    bne     fe_cpy
fe_ret:
    ret     [d2,d3,a2,a3], 0x30

# AnswerText -> a1 = what request 5 shows: starting, or why KN7FM cannot run ("KN7FM: NO DSP 06"). Keeps a0. Leaf.
AnswerText:
    mov     (V_STATE), d0
    cmp     ST_FAIL, d0
    beq     at_fail
    mov     msg_start, a1
    rets
at_fail:
    mov     (V_FAIL), d0
    mov     d0, d1
    and     0xFF, d1                # d1 = the step or the reason
    lsr     8, d0
    cmp     FAIL_FW >> 8, d0
    beq     at_fw
    cmp     FAIL_DSP >> 8, d0
    beq     at_dsp
    mov     msg_task, a1
    rets
at_fw:
    mov     d1, d0                  # two digits into the message's last two characters
    clr     d1
    mov     d1, mdr
    mov     10, d1
    divu    d1, d0
    add     0x30, d0
    movbu   d0, (msg_fw_d)
    mov     mdr, d0
    add     0x30, d0
    movbu   d0, (msg_fw_d + 1)
    mov     msg_fw, a1
    rets
at_dsp:
    mov     d1, d0
    clr     d1
    mov     d1, mdr
    mov     10, d1
    divu    d1, d0
    add     0x30, d0
    movbu   d0, (msg_dsp_d)
    mov     mdr, d0
    add     0x30, d0
    movbu   d0, (msg_dsp_d + 1)
    mov     msg_dsp, a1
    rets
# =================================================================================================================
# Files: BANKn.SYX in the program's folder, read into or written from FILEBUF (on the main task).

# LaunchFolder: PREFIX = the folder the program menu started us from ("KN7FM\"), from its launch block; "" when
# the loader started us from the root (Another World's cnv_main.s LaunchFolder). Leaf.
LaunchFolder:
    clr     d0
    movbu   d0, (PREFIX)
    mov     (LB_ADDR+LB_MAGIC), d0
    mov     LAUNCH_MAGIC, d1
    cmp     d1, d0
    bne     lnf_ret
    mov     (LB_ADDR+LB_CHECK), d0
    mov     LAUNCH_CHECK, d1
    cmp     d1, d0
    bne     lnf_ret
    mov     (LB_ADDR+LB_ABI), d0
    cmp     LAUNCH_ABI, d0
    bne     lnf_ret
    mov     LB_ADDR+LB_PREFIX, a0
    mov     PREFIX, a1
    mov     15, d1
lnf_cpy:
    movbu   (a0), d0
    movbu   d0, (a1)
    cmp     0, d0
    beq     lnf_ret
    inc     a0
    inc     a1
    add     -1, d1
    bne     lnf_cpy
    clr     d0
    movbu   d0, (a1)
lnf_ret:
    rets

# BankPath -> a0 = PATHBUF: PREFIX and "BANKn.SYX", n = V_FILENO. Leaf.
BankPath:
    mov     PREFIX, a1
    mov     PATHBUF, a0
    mov     15, d1
bp_pre:
    movbu   (a1), d0
    cmp     0, d0
    beq     bp_name
    movbu   d0, (a0)
    inc     a0
    inc     a1
    add     -1, d1
    bne     bp_pre
bp_name:
    mov     str_bankfile, a1
bp_nm:
    movbu   (a1), d0
    movbu   d0, (a0)
    inc     a0
    inc     a1
    cmp     0, d0
    bne     bp_nm
    add     -6, a0                  # the digit: "BANK0.SYX" with 5 characters after it and the NUL
    mov     (V_FILENO), d0
    add     0x30, d0
    movbu   d0, (a0)
    mov     PATHBUF, a0
    rets

# ReadBank -> d0 = 0 and V_FBYTES = the bytes read into FILEBUF (at most SYX_LEN + 64), or 1 (no such file).
ReadBank:
    movm    [d2,d3,a2,a3], (sp)
    add     -0x20, sp
    mov     1, d2                   # the result
    mov     1, d0
    mov     (FW_SETEXT), a3
    calls   (a3)
    call    BankPath, 0, 0
    mov     mode_rb, a1
    mov     (FW_OPEN), a3
    calls   (a3)
    exth    d0
    cmp     0, d0
    blt     rb_back
    mov     FILEBUF, a0
    mov     SYX_LEN + 64, d0
    mov     (FW_READ), a3
    calls   (a3)
    mov     d0, (V_FBYTES)
    mov     (FW_CLOSE), a3
    calls   (a3)
    clr     d2
rb_back:
    mov     (FW_RESETEXT), a3
    calls   (a3)
    mov     d2, d0
    ret     [d2,d3,a2,a3], 0x30

# WriteBank -> d0 = 0 when FILEBUF's SYX_LEN bytes (BankToFile) went whole into BANKn.SYX; else 1.
WriteBank:
    movm    [d2,d3,a2,a3], (sp)
    add     -0x20, sp
    mov     1, d2
    mov     (FW_WRITE), d0
    cmp     0, d0
    beq     wb_ret
    mov     1, d0
    mov     (FW_SETEXT), a3
    calls   (a3)
    call    BankPath, 0, 0
    mov     mode_wb, a1
    mov     (FW_OPEN), a3
    calls   (a3)
    exth    d0
    cmp     0, d0
    blt     wb_back
    mov     FILEBUF, a0
    mov     SYX_LEN, d0
    mov     (FW_WRITE), a3
    calls   (a3)
    mov     d0, (V_FBYTES)
    mov     (FW_CLOSE), a3
    calls   (a3)
    mov     (V_FBYTES), d0
    cmp     SYX_LEN, d0
    bne     wb_back
    clr     d2
wb_back:
    mov     (FW_RESETEXT), a3
    calls   (a3)
wb_ret:
    mov     d2, d0
    ret     [d2,d3,a2,a3], 0x30

# =================================================================================================================
# The task.

# StartTask -> d0 = 0 when our task was created and started (slot 10, else 9); else 1.
StartTask:
    movm    [d2,d3,a2,a3], (sp)
    add     -0x20, sp
    mov     TASK_ID_FIRST, d2
st_try:
    mov     d2, d0
    mov     fm_ctsk, a0
    mov     (FW_CRE), a1
    calls   (a1)
    cmp     0, d0                   # E_OK
    beq     st_start
    add     -1, d2
    cmp     TASK_ID_LAST, d2
    bge     st_try
    mov     1, d0
    bra     st_ret
st_start:
    mov     d2, (V_TASKID)
    clr     d0
    mov     d0, (V_TASKDONE)
    mov     d2, d0
    clr     d1
    mov     (FW_STA), a1
    calls   (a1)
    clr     d0
st_ret:
    ret     [d2,d3,a2,a3], 0x30

# FmTask: the synthesizer's loop (it never returns: on quit it ends itself with exd_tsk).
FmTask:
    add     -0x20, sp
    mov     SETTLE_MS, d0           # let the firmware draw its converter screen first: ours goes over it
    mov     (FW_DLY), a0
    calls   (a0)
    call    NotesInit, 0, 0
    mov     1, d0                   # the keybed's own sound off: only ours
    mov     d0, (V_KEYWANT)
    call    KeysSync, 0, 0
    mov     1, d0
    mov     d0, (V_SCALE)
    mov     D_ALL, d0
    mov     d0, (V_DIRTY)
    call    UiNow, 0, 0
    mov     d0, (V_LOOP_T0)
ft_loop:
    mov     (V_QUIT), d0
    cmp     0, d0
    bne     ft_quit
    call    NotePoll, 0, 0          # the notes first, every pass
    call    UiPoll, 0, 0
    call    NotePoll, 0, 0
    call    UiDraw, 0, 0
    call    UiNow, 0, 0             # twice a second: the screen still ours? the frame rate, the keybed's mute
    mov     (V_LOOP_T0), d1
    sub     d1, d0
    cmp     500, d0
    bcs     ft_yield
    call    UiNow, 0, 0
    mov     d0, (V_LOOP_T0)
    call    LcdCheck, 0, 0
    call    DspRate, 0, 0
    call    KeysSync, 0, 0
    call    DspWatch, 0, 0          # the firmware has left without us: stop
    cmp     0, d0
    bne     ft_quit
ft_yield:
    mov     1, d0
    mov     (FW_DLY), a0
    calls   (a0)
    bra     ft_loop
ft_quit:
    call    AllNotesOff, 0, 0       # every voice released, the keybed's sound back
    call    KeysRestore, 0, 0
    mov     1, d0
    mov     d0, (V_TASKDONE)
    mov     (FW_EXD), a0
    calls   (a0)                    # exit and delete this task; does not return
ft_hang:
    bra     ft_hang

# ---- data ------------------------------------------------------------------------------------------------------
    .align  4
fm_ctsk:                            # T_CTSK for cre_tsk (Another World's game_ctsk)
    .long   0
    .long   1
    .long   FmTask
    .word   TASK_PRI
    .word   0
    .long   TASK_STACK
mode_rb:        .asciz  "rb"
mode_wb:        .asciz  "wb"
str_bankfile:   .asciz  "BANK0.SYX"
msg_start:      .asciz  "KN7FM: starting..."
msg_fw:         .ascii  "KN7FM: UNKNOWN FIRMWARE "
msg_fw_d:       .asciz  "00"
msg_dsp:        .ascii  "KN7FM: NO DSP "
msg_dsp_d:      .asciz  "00"
msg_task:       .asciz  "KN7FM: NO TASK"
    .align  4

.include "fwfind.s"                 # the firmware search (Another World's)
.include "dsp.s"                    # the effects DSP (its program: dsp_data.inc)
.include "synth.s"                  # notes, voices, patches, the bank
.include "ui.s"                     # the screen and the panel
.include "fm_tables.inc"            # generated by tools/fm_host.py: msfa's tables, the diagrams, the built-in bank
.include "font8x13.inc"             # the loader's font
IMAGE_END:
